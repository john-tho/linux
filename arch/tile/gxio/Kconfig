## arch/tile/gxio/Kconfig
```kconfig
# SPDX-License-Identifier: GPL-2.0
# Support direct access to TILE-Gx hardware from user space, via the
# gxio library, or from kernel space, via kernel IORPC support.
config TILE_GXIO
	bool
	depends on TILEGX

# Support direct access to the common I/O DMA facility within the
# TILE-Gx mPIPE and Trio hardware from kernel space.
config TILE_GXIO_DMA
	bool
	select TILE_GXIO

# Support direct access to the TILE-Gx mPIPE hardware from kernel space.
config TILE_GXIO_MPIPE
	bool
	default y
	select TILE_GXIO
	select TILE_GXIO_DMA

config TILE_GXIO_GPIO
        bool "Tilera Gx GPIO I/O support"
        default y
	select TILE_GXIO
       ---help---
          This option supports direct access to the TILE-Gx GPIO hardware
	  from kernel space.  It is not required in order to use the gxio
	  library to access GPIO pins from user space.

# Support direct access to the TILE-Gx TRIO hardware from kernel space.
config TILE_GXIO_TRIO
	bool
	select TILE_GXIO
	select TILE_GXIO_DMA

# Support direct access to the TILE-Gx USB hardware from kernel space.
config TILE_GXIO_USB_HOST
	bool
	depends on TILEGX
	select TILE_GXIO

config TILE_GXIO_PKA
	bool "Tilera Gx Public Key Accelerator support"
	default y
	select TILE_GXIO
	---help---
	  This option supports direct access to the TILE-Gx PKA hardware
	  from kernel space.

config TILE_GXIO_MICA
	bool "Tilera TILE-Gx Crypto Hardware Acceleration support"
	depends on TILEGX
	default y
	select TILE_GXIO
	---help---
	  This options supports direct access to the crypto acceleration
	  hardware from kernel space.

config TILE_GXIO_GXCR
	bool "Tilera TILE-Gx Crypto library support"
	depends on TILEGX
	default y
	select TILE_GXIO_MICA
	---help---
	  This options supports a mid-level API for access to the
	  Tilera TILE-Gx crypto accelerator engine from kernel space.

# Support direct access to the TILE-Gx UART hardware from kernel space.
config TILE_GXIO_UART
	bool "Tilera TILE-Gx UART support"
	depends on TILEGX
	default y
	select TILE_GXIO
```

## drivers/soc/alpine/Kconfig
```kconfig
#
# Alpine SoC drivers configuration
#

menuconfig AL_HAL
	depends on ARM || ARM64
        tristate "Alpine Hardware Abstraction Layer"
        help
          Enable this to get Alpine HAL support

config ALPINE_PLATFORM
	depends on ARM || ARM64
	string "Alpine Platform Type"
	help
		choose Alpine SOC type (e.g. TOPROCK).
```
