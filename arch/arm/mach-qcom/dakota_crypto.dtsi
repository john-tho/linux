/dts-v1/;
/ {
	soc {
		qcom,sps {
			compatible = "qcom,msm_sps_4k";
			qcom,device-type = <3>;
			qcom,pipe-attr-ee;
		};
		qcrypto {
			compatible = "qcom,qcrypto";
			reg = <0x8e20000 0x20000>,
			      <0x8e04000 0x20000>;
			reg-names = "crypto-base","crypto-bam-base";
			interrupts = <0 207 0>;
			clocks = <&gcc GCC_CRYPTO_CLK>,
				<&gcc GCC_CRYPTO_AXI_CLK>,
				<&gcc GCC_CRYPTO_AHB_CLK>;
			clock-names = "core_clk", "bus_clk", "iface_clk";
		};
        };
};
